#include <Adafruit_GFX.h>
#include <Adafruit_SSD1306.h>

#define SCREEN_WIDTH 128
#define SCREEN_HEIGHT 64
#define OLED_RESET -1
#define SCREEN_ADDRESS 0x3C

#define FRAME_DELAY (20)
#define COUNTER_DELAY (700)
#define FRAME_ANIMATOR_WIDTH (50)
#define FRAME_ANIMATOR_HEIGHT (50)
#define FRAME_NUM_WIDTH (50)
#define FRAME_NUM_HEIGHT (50)

Adafruit_SSD1306 display(SCREEN_WIDTH, SCREEN_HEIGHT, &Wire, OLED_RESET);

// 'icons8-1-50', 50x50px
const unsigned char num_1 [350] PROGMEM = {
	0xff, 0xff, 0xff, 0xff, 0xff, 0xff, 0xc0, 0xff, 0xff, 0xff, 0xff, 0xff, 0xff, 0xc0, 0xff, 0xff, 
	0xff, 0xff, 0xff, 0xff, 0xc0, 0xff, 0xff, 0xff, 0xff, 0xff, 0xff, 0xc0, 0xff, 0xff, 0xff, 0xff, 
	0xff, 0xff, 0xc0, 0xff, 0xff, 0xff, 0xff, 0xff, 0xff, 0xc0, 0xff, 0xc0, 0x00, 0x00, 0x00, 0xff, 
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	0xff, 0xff, 0xff, 0xff, 0xff, 0xff, 0xc0, 0xff, 0xff, 0xff, 0xff, 0xff, 0xff, 0xc0
};
// 'icons8-2-50 (1)', 50x50px
const unsigned char num_2 [350] PROGMEM = {
	0xff, 0xff, 0xff, 0xff, 0xff, 0xff, 0xc0, 0xff, 0xff, 0xff, 0xff, 0xff, 0xff, 0xc0, 0xff, 0xff, 
	0xff, 0xff, 0xff, 0xff, 0xc0, 0xff, 0xff, 0xff, 0xff, 0xff, 0xff, 0xc0, 0xff, 0xff, 0xff, 0xff, 
	0xff, 0xff, 0xc0, 0xff, 0xff, 0xff, 0xff, 0xff, 0xff, 0xc0, 0xff, 0xc0, 0x00, 0x00, 0x00, 0xff, 
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	0xff, 0xff, 0xff, 0xff, 0xff, 0xff, 0xc0, 0xff, 0xff, 0xff, 0xff, 0xff, 0xff, 0xc0
};

// 'icons8-3-50', 50x50px
const unsigned char num_3 [350] PROGMEM = {
	0xff, 0xff, 0xff, 0xff, 0xff, 0xff, 0xc0, 0xff, 0xff, 0xff, 0xff, 0xff, 0xff, 0xc0, 0xff, 0xff, 
	0xff, 0xff, 0xff, 0xff, 0xc0, 0xff, 0xff, 0xff, 0xff, 0xff, 0xff, 0xc0, 0xff, 0xff, 0xff, 0xff, 
	0xff, 0xff, 0xc0, 0xff, 0xff, 0xff, 0xff, 0xff, 0xff, 0xc0, 0xff, 0xc0, 0x00, 0x00, 0x00, 0xff, 
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	0xff, 0xff, 0xff, 0xff, 0xff, 0xff, 0xc0, 0xff, 0xff, 0xff, 0xff, 0xff, 0xff, 0xc0
};

// 'icons8-go-50', 50x50px
const unsigned char go [350] PROGMEM = {
	0xff, 0xff, 0xff, 0xff, 0xff, 0xff, 0xc0, 0xff, 0xff, 0xff, 0xff, 0xff, 0xff, 0xc0, 0xff, 0xff, 
	0xf0, 0x03, 0xff, 0xff, 0xc0, 0xff, 0xff, 0x80, 0x00, 0x7f, 0xff, 0xc0, 0xff, 0xfe, 0x0f, 0xfc, 
	0x1f, 0xff, 0xc0, 0xff, 0xf8, 0x7f, 0xff, 0x87, 0xff, 0xc0, 0xff, 0xe1, 0xff, 0xff, 0xe1, 0xff, 
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	0xff, 0xff, 0xff, 0xff, 0xff, 0xff, 0xc0, 0xff, 0xff, 0xff, 0xff, 0xff, 0xff, 0xc0
};


// ===========================================================
// Animation Shaking Fist
// 'frame_06_delay-0', 50x50px
const unsigned char fist_ani7 [350] PROGMEM = {
	0xff, 0xff, 0xff, 0xff, 0xff, 0xff, 0xc0, 0xff, 0xff, 0xff, 0xff, 0xff, 0xff, 0xc0, 0xff, 0xff, 
	0xff, 0xff, 0xff, 0xff, 0xc0, 0xff, 0xff, 0xff, 0xff, 0xff, 0xff, 0xc0, 0xff, 0xff, 0xff, 0xff, 
	0xff, 0xff, 0xc0, 0xff, 0xff, 0xff, 0xff, 0xff, 0xff, 0xc0, 0xff, 0xff, 0xff, 0xff, 0xff, 0xff, 
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	0xff, 0xfe, 0xff, 0xff, 0xff, 0xff, 0xc0, 0xff, 0xff, 0xff, 0xff, 0xff, 0xff, 0xc0
};
// 'frame_07_delay-0', 50x50px
const unsigned char fist_ani8 [350] PROGMEM = {
	0xff, 0xff, 0xff, 0xff, 0xff, 0xff, 0xc0, 0xff, 0xff, 0xff, 0xff, 0xff, 0xff, 0xc0, 0xff, 0xff, 
	0xff, 0xff, 0xff, 0xff, 0xc0, 0xff, 0xff, 0xff, 0xff, 0xff, 0xff, 0xc0, 0xff, 0xff, 0xff, 0xff, 
	0xff, 0xff, 0xc0, 0xff, 0xff, 0xff, 0xff, 0xff, 0xff, 0xc0, 0xff, 0xff, 0xff, 0xff, 0xff, 0xff, 
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	0xff, 0xfe, 0xff, 0xff, 0xff, 0xff, 0xc0, 0xff, 0xff, 0xff, 0xff, 0xff, 0xff, 0xc0
};
// 'frame_08_delay-0', 50x50px
const unsigned char fist_ani9 [350] PROGMEM = {
	0xff, 0xff, 0xff, 0xff, 0xff, 0xff, 0xc0, 0xff, 0xff, 0xff, 0xff, 0xff, 0xff, 0xc0, 0xff, 0xff, 
	0xff, 0xff, 0xff, 0xff, 0xc0, 0xff, 0xff, 0xff, 0xff, 0xff, 0xff, 0xc0, 0xff, 0xff, 0xff, 0xff, 
	0xff, 0xff, 0xc0, 0xff, 0xff, 0xff, 0xff, 0xff, 0xff, 0xc0, 0xff, 0xff, 0xff, 0xc7, 0xff, 0xff, 
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	0xff, 0xff, 0xff, 0xff, 0xff, 0xff, 0xc0, 0xff, 0xff, 0xff, 0xff, 0xff, 0xff, 0xc0
};
// 'frame_09_delay-0', 50x50px
const unsigned char fist_ani10 [350] PROGMEM = {
	0xff, 0xff, 0xff, 0xff, 0xff, 0xff, 0xc0, 0xff, 0xff, 0xff, 0xff, 0xff, 0xff, 0xc0, 0xff, 0xff, 
	0xff, 0xff, 0xff, 0xff, 0xc0, 0xff, 0xff, 0xff, 0xff, 0xff, 0xff, 0xc0, 0xff, 0xff, 0xff, 0xff, 
	0xff, 0xff, 0xc0, 0xff, 0xff, 0xff, 0x9f, 0xff, 0xff, 0xc0, 0xff, 0xff, 0xfe, 0x07, 0xff, 0xff, 
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	0xff, 0xff, 0xff, 0xff, 0xff, 0xff, 0xc0, 0xff, 0xff, 0xff, 0xff, 0xff, 0xff, 0xc0
};
const unsigned char fist_ani11 [350] PROGMEM = {
	0xff, 0xff, 0xff, 0xff, 0xff, 0xff, 0xc0, 0xff, 0xff, 0xff, 0xff, 0xff, 0xff, 0xc0, 0xff, 0xff, 
	0xff, 0xff, 0xff, 0xff, 0xc0, 0xff, 0xff, 0xff, 0xff, 0xff, 0xff, 0xc0, 0xff, 0xff, 0xff, 0xff, 
	0xff, 0xff, 0xc0, 0xff, 0xff, 0xff, 0x9f, 0xff, 0xff, 0xc0, 0xff, 0xff, 0xfe, 0x07, 0xff, 0xff, 
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	0xff, 0xff, 0xff, 0xff, 0xff, 0xff, 0xc0, 0xff, 0xff, 0xff, 0xff, 0xff, 0xff, 0xc0
};


// ===========================================================
// Animation Fist Scissor
// 'frame_13_delay-0', 50x50px
const unsigned char fist_scissor_ani7 [350] PROGMEM = {
	0xff, 0xff, 0xff, 0xff, 0xff, 0xff, 0xc0, 0xff, 0xff, 0xff, 0xff, 0xe3, 0xff, 0xc0, 0xff, 0xff, 
	0xff, 0xff, 0x81, 0xff, 0xc0, 0xff, 0xff, 0xff, 0xff, 0x18, 0xff, 0xc0, 0xff, 0xff, 0xff, 0xfe, 
	0x3c, 0xff, 0xc0, 0xff, 0xff, 0xff, 0xfc, 0x7c, 0xff, 0xc0, 0xff, 0xff, 0xff, 0xfc, 0xf8, 0xff, 
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	0xff, 0xfe, 0xff, 0xff, 0xff, 0xff, 0xc0, 0xff, 0xff, 0xff, 0xff, 0xff, 0xff, 0xc0
};
// 'frame_14_delay-0', 50x50px
const unsigned char fist_scissor_ani8 [350] PROGMEM = {
	0xff, 0xff, 0xff, 0xff, 0xff, 0xff, 0xc0, 0xff, 0xff, 0xff, 0xff, 0xe3, 0xff, 0xc0, 0xff, 0xff, 
	0xff, 0xff, 0x81, 0xff, 0xc0, 0xff, 0xff, 0xff, 0xff, 0x18, 0xff, 0xc0, 0xff, 0xff, 0xff, 0xfe, 
	0x3c, 0xff, 0xc0, 0xff, 0xff, 0xff, 0xfc, 0x7c, 0xff, 0xc0, 0xff, 0xff, 0xff, 0xfc, 0xf8, 0xff, 
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	0xff, 0xfe, 0xff, 0xff, 0xff, 0xff, 0xc0, 0xff, 0xff, 0xff, 0xff, 0xff, 0xff, 0xc0
};
// 'frame_15_delay-0', 50x50px
const unsigned char fist_scissor_ani9 [350] PROGMEM = {
	0xff, 0xff, 0xff, 0xff, 0xff, 0xff, 0xc0, 0xff, 0xff, 0xff, 0xff, 0xe3, 0xff, 0xc0, 0xff, 0xff, 
	0xff, 0xff, 0x81, 0xff, 0xc0, 0xff, 0xff, 0xff, 0xff, 0x18, 0xff, 0xc0, 0xff, 0xff, 0xff, 0xfe, 
	0x3c, 0xff, 0xc0, 0xff, 0xff, 0xff, 0xfc, 0x7c, 0xff, 0xc0, 0xff, 0xff, 0xff, 0xfc, 0xf8, 0xff, 
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	0xff, 0xfe, 0xff, 0xff, 0xff, 0xff, 0xc0, 0xff, 0xff, 0xff, 0xff, 0xff, 0xff, 0xc0
};
// 'frame_16_delay-0', 50x50px
const unsigned char fist_scissor_ani10 [350] PROGMEM = {
	0xff, 0xff, 0xff, 0xff, 0xff, 0xff, 0xc0, 0xff, 0xff, 0xff, 0xff, 0xe3, 0xff, 0xc0, 0xff, 0xff, 
	0xff, 0xff, 0x81, 0xff, 0xc0, 0xff, 0xff, 0xff, 0xff, 0x18, 0xff, 0xc0, 0xff, 0xff, 0xff, 0xfe, 
	0x3c, 0xff, 0xc0, 0xff, 0xff, 0xff, 0xfc, 0x7c, 0xff, 0xc0, 0xff, 0xff, 0xff, 0xfc, 0xf8, 0xff, 
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	0xff, 0xfe, 0xff, 0xff, 0xff, 0xff, 0xc0, 0xff, 0xff, 0xff, 0xff, 0xff, 0xff, 0xc0
};



// ===========================================================
// Animation Fist Rock
// 'frame_15_delay-0', 50x50px
const unsigned char fist_rock_ani7 [350] PROGMEM = {
	0xff, 0xff, 0xff, 0xff, 0xff, 0xff, 0xc0, 0xff, 0xff, 0xff, 0xff, 0xff, 0xff, 0xc0, 0xff, 0xff, 
	0xff, 0xff, 0xff, 0xff, 0xc0, 0xff, 0xff, 0xff, 0xff, 0xff, 0xff, 0xc0, 0xff, 0xff, 0xff, 0xff, 
	0xff, 0xff, 0xc0, 0xff, 0xff, 0xff, 0xff, 0xff, 0xff, 0xc0, 0xff, 0xff, 0xff, 0xff, 0xff, 0xff, 
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	0xff, 0xfe, 0xff, 0xff, 0xff, 0xff, 0xc0, 0xff, 0xff, 0xff, 0xff, 0xff, 0xff, 0xc0
};
// 'frame_16_delay-0', 50x50px
const unsigned char fist_rock_ani8 [350] PROGMEM = {
	0xff, 0xff, 0xff, 0xff, 0xff, 0xff, 0xc0, 0xff, 0xff, 0xff, 0xff, 0xff, 0xff, 0xc0, 0xff, 0xff, 
	0xff, 0xff, 0xff, 0xff, 0xc0, 0xff, 0xff, 0xff, 0xff, 0xff, 0xff, 0xc0, 0xff, 0xff, 0xff, 0xff, 
	0xff, 0xff, 0xc0, 0xff, 0xff, 0xff, 0xff, 0xff, 0xff, 0xc0, 0xff, 0xff, 0xff, 0xff, 0xff, 0xff, 
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	0xff, 0xfe, 0xff, 0xff, 0xff, 0xff, 0xc0, 0xff, 0xff, 0xff, 0xff, 0xff, 0xff, 0xc0
};
// 'frame_17_delay-0', 50x50px
const unsigned char fist_rock_ani9 [350] PROGMEM = {
	0xff, 0xff, 0xff, 0xff, 0xff, 0xff, 0xc0, 0xff, 0xff, 0xff, 0xff, 0xff, 0xff, 0xc0, 0xff, 0xff, 
	0xff, 0xff, 0xff, 0xff, 0xc0, 0xff, 0xff, 0xff, 0xff, 0xff, 0xff, 0xc0, 0xff, 0xff, 0xff, 0xff, 
	0xff, 0xff, 0xc0, 0xff, 0xff, 0xff, 0xff, 0xff, 0xff, 0xc0, 0xff, 0xff, 0xff, 0xff, 0xff, 0xff, 
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	0xff, 0xfe, 0xff, 0xff, 0xff, 0xff, 0xc0, 0xff, 0xff, 0xff, 0xff, 0xff, 0xff, 0xc0
};
// 'frame_18_delay-0', 50x50px
const unsigned char fist_rock_ani10 [350] PROGMEM = {
	0xff, 0xff, 0xff, 0xff, 0xff, 0xff, 0xc0, 0xff, 0xff, 0xff, 0xff, 0xff, 0xff, 0xc0, 0xff, 0xff, 
	0xff, 0xff, 0xff, 0xff, 0xc0, 0xff, 0xff, 0xff, 0xff, 0xff, 0xff, 0xc0, 0xff, 0xff, 0xff, 0xff, 
	0xff, 0xff, 0xc0, 0xff, 0xff, 0xff, 0xff, 0xff, 0xff, 0xc0, 0xff, 0xff, 0xff, 0xff, 0xff, 0xff, 
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	0xff, 0xfe, 0xff, 0xff, 0xff, 0xff, 0xc0, 0xff, 0xff, 0xff, 0xff, 0xff, 0xff, 0xc0
};






// ===========================================================
// Animation Fist Paper 

// 'frame_12_delay-0', 50x50px
const unsigned char fist_paper_ani7 [350] PROGMEM = {
	0xff, 0xff, 0xff, 0xff, 0xff, 0xff, 0xc0, 0xff, 0xff, 0xff, 0xff, 0xff, 0xff, 0xc0, 0xff, 0xff, 
	0xff, 0xff, 0xff, 0xff, 0xc0, 0xff, 0xff, 0xff, 0xff, 0xf8, 0x7f, 0xc0, 0xff, 0xff, 0xff, 0xc3, 
	0xe0, 0x3f, 0xc0, 0xff, 0xff, 0xff, 0x81, 0xc7, 0x1f, 0xc0, 0xff, 0xff, 0xfe, 0x18, 0x0f, 0x80, 
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	0xff, 0xfc, 0xff, 0xff, 0xff, 0xff, 0xc0, 0xff, 0xff, 0xff, 0xff, 0xff, 0xff, 0xc0
};
// 'frame_13_delay-0', 50x50px
const unsigned char fist_paper_ani8 [350] PROGMEM = {
	0xff, 0xff, 0xff, 0xff, 0xff, 0xff, 0xc0, 0xff, 0xff, 0xff, 0xff, 0xff, 0xff, 0xc0, 0xff, 0xff, 
	0xff, 0xff, 0xff, 0xff, 0xc0, 0xff, 0xff, 0xff, 0xff, 0xf8, 0x3f, 0xc0, 0xff, 0xff, 0xff, 0xc1, 
	0xe0, 0x1f, 0xc0, 0xff, 0xff, 0xff, 0x01, 0xc7, 0x9f, 0xc0, 0xff, 0xff, 0xfe, 0x1c, 0x0f, 0x80, 
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	0xff, 0xfe, 0xff, 0xff, 0xff, 0xff, 0xc0, 0xff, 0xff, 0xff, 0xff, 0xff, 0xff, 0xc0
};
// 'frame_14_delay-0', 50x50px
const unsigned char fist_paper_ani9 [350] PROGMEM = {
	0xff, 0xff, 0xff, 0xff, 0xff, 0xff, 0xc0, 0xff, 0xff, 0xff, 0xff, 0xff, 0xff, 0xc0, 0xff, 0xff, 
	0xff, 0xff, 0xff, 0xff, 0xc0, 0xff, 0xff, 0xff, 0xff, 0xf8, 0x3f, 0xc0, 0xff, 0xff, 0xff, 0xc1, 
	0xe0, 0x1f, 0xc0, 0xff, 0xff, 0xff, 0x01, 0xc7, 0x9f, 0xc0, 0xff, 0xff, 0xfe, 0x1c, 0x0f, 0x80, 
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	0xff, 0xfe, 0xff, 0xff, 0xff, 0xff, 0xc0, 0xff, 0xff, 0xff, 0xff, 0xff, 0xff, 0xc0
};
// 'frame_15_delay-0', 50x50px
const unsigned char fist_paper_ani10 [350] PROGMEM = {
	0xff, 0xff, 0xff, 0xff, 0xff, 0xff, 0xc0, 0xff, 0xff, 0xff, 0xff, 0xff, 0xff, 0xc0, 0xff, 0xff, 
	0xff, 0xff, 0xff, 0xff, 0xc0, 0xff, 0xff, 0xff, 0xff, 0xf8, 0x3f, 0xc0, 0xff, 0xff, 0xff, 0xc1, 
	0xe0, 0x1f, 0xc0, 0xff, 0xff, 0xff, 0x01, 0xc7, 0x9f, 0xc0, 0xff, 0xff, 0xfe, 0x1c, 0x0f, 0x80, 
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	0xff, 0xfe, 0xff, 0xff, 0xff, 0xff, 0xc0, 0xff, 0xff, 0xff, 0xff, 0xff, 0xff, 0xc0
};

const unsigned char* fist_frames[] = {
    fist_ani7,
    fist_ani8,
    fist_ani9,
    fist_ani10,
		fist_ani11};

const unsigned char* paper_frames[] = {
    fist_paper_ani7,
    fist_paper_ani8,
    fist_paper_ani9,
    fist_paper_ani10};
const unsigned char* rock_frames[] = {
    fist_rock_ani7,
    fist_rock_ani8,
    fist_rock_ani9,
    fist_rock_ani10};

const unsigned char* scissor_frames[] = {
    fist_scissor_ani7,
    fist_scissor_ani8,
    fist_scissor_ani9,
    fist_scissor_ani10};

// ===========================================================


const int scissor_num_frames = (sizeof(scissor_frames) / sizeof(scissor_frames[0]));
const int paper_num_frames = (sizeof(paper_frames) / sizeof(paper_frames[0]));
const int rock_num_frames = (sizeof(rock_frames) / sizeof(rock_frames[0]));
const int fist_num_frames = (sizeof(fist_frames) / sizeof(fist_frames[0]));


int ani_spriteX = 15;
int ani_spriteY = 13;

int num_spriteX = 65;
int num_spriteY = 13;

int frame = 0;
int timeCounter = -1; 
boolean isPlaying = false;
unsigned long shakeTime = 0;
unsigned long countTime = 0;

// Push button
int buttonState;
int pushCounter = 0;
int buttonPin = 7;
int lastButtonState = LOW; // is not push with current set up

void setup() {
  // put your setup code here, to run once:
  Serial.begin(9600);
  randomSeed(analogRead(0)); // Initialize random seed
  if(!display.begin(SSD1306_SWITCHCAPVCC, SCREEN_ADDRESS)) {
    Serial.println(F("SSD1306 allocation failed"));
    for(;;);
  }
	pinMode(buttonPin,INPUT_PULLUP);
}



void loop() {
  // put your main code here, to run repeatedly:
   buttonState = digitalRead(buttonPin);
	 if(lastButtonState != buttonState ){
		if(!isPlaying){
    		pushCounter++;
		}
    lastButtonState = buttonState;
  }
  
  if(pushCounter == 2 ){
		isPlaying = true;
		play();
		if(!isPlaying){
			reset();
		}
  } 
			
}

void reset(){
	timeCounter = -1; 
	pushCounter = 0; 
	isPlaying = false;
	shakeTime = 0;
	countTime = 0;
	frame = 0;
}

void play(){
	display.clearDisplay();
	unsigned long currentTime = millis();
	if(isPlaying){
			int frameLength = 0;
			// Counting
			if(getGameStage() == 0){
				if (currentTime - shakeTime >= FRAME_DELAY ) {			
					drawAnimation (-1 , frame);
					drawNumber(timeCounter);
					display.display();
					frameLength =  getFrameLength(-1);
					frame = (frame + 1) % frameLength;
					shakeTime = currentTime;
  		}

				if (currentTime - countTime >= COUNTER_DELAY ) {		
					timeCounter++;
					countTime = currentTime;		
				}

			}
			

			
			if(getGameStage() == 1){
					clearNumberScreen();
					display.drawBitmap(num_spriteX, num_spriteY, go, FRAME_NUM_WIDTH, FRAME_NUM_HEIGHT, 1 );

					frame = 0;
					int randomNum = random(3); // 1 : rock , 2: paper, 3: scissor
					frameLength =  getFrameLength(randomNum);
					do{
								// clear display
								clearAnimationScreen();
								drawAnimation (randomNum, frame);
								display.display();
								
								frame = (frame + 1) % frameLength;
								delay(FRAME_DELAY);
						} while (frame < frameLength - 1);

					isPlaying = false;
			
	}
}
}

int getFrameLength (int indicatedNum) {
	switch (indicatedNum){
		case -1 : return fist_num_frames ; break;
		case 0 : return rock_num_frames ; break;
		case 1 : return paper_num_frames; break;
		case 2 : return scissor_num_frames; break;
	}
}

void drawAnimation(int indicatedNum , int frame){
	//Clear the number first 
	switch (indicatedNum){
		case -1 : display.drawBitmap(ani_spriteX, ani_spriteY, fist_frames[frame], FRAME_ANIMATOR_WIDTH, FRAME_ANIMATOR_HEIGHT, 1 ); break;
		case 0 : display.drawBitmap(ani_spriteX, ani_spriteY, rock_frames[frame], FRAME_ANIMATOR_WIDTH, FRAME_ANIMATOR_HEIGHT, 1 ); break;
		case 1 : display.drawBitmap(ani_spriteX, ani_spriteY, paper_frames[frame], FRAME_ANIMATOR_WIDTH, FRAME_ANIMATOR_HEIGHT, 1 ); break;
		case 2 : display.drawBitmap(ani_spriteX, ani_spriteY, scissor_frames[frame], FRAME_ANIMATOR_WIDTH, FRAME_ANIMATOR_HEIGHT, 1 ); break;
	}

}

void drawNumber(int counter){
	//Clear the number first 
	clearNumberScreen();
	if(counter == 0){
		display.drawBitmap(num_spriteX, num_spriteY, num_3, FRAME_NUM_WIDTH, FRAME_NUM_HEIGHT, 1 );
	} else if(counter == 1){
		display.drawBitmap(num_spriteX, num_spriteY, num_2, FRAME_NUM_WIDTH, FRAME_NUM_HEIGHT, 1 );
	}else if(counter == 2){
		display.drawBitmap(num_spriteX, num_spriteY, num_1, FRAME_NUM_WIDTH, FRAME_NUM_HEIGHT, 1 );
	}
}

void clearNumberScreen(){
	display.fillRect(num_spriteX, num_spriteY,FRAME_NUM_WIDTH, FRAME_NUM_HEIGHT, BLACK);
}

void clearAnimationScreen(){
	display.fillRect(ani_spriteX, ani_spriteY,FRAME_ANIMATOR_WIDTH, FRAME_ANIMATOR_HEIGHT, BLACK);
}

int getGameStage(){
	if(timeCounter < 3){
		return 0; // counting stage
	} else {
		return 1; // result stage
	}
}
